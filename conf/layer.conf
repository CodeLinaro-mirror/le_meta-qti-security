## conf/layer.conf
```bitbake
BBPATH .= ":${LAYERDIR}"

BBFILE_COLLECTIONS          += "qti-security"
BBFILE_PRIORITY_qti-security = "17"
BBFILE_PATTERN_qti-security := "^${LAYERDIR}/"

LAYERDEPENDS_qti-sec = "core"
LAYERSERIES_COMPAT_qti-sec = "dunfell"
LAYERVERSION_qti-sec = "1"

BBFILES += "${LAYERDIR}/recipes/*/*.bb \
            ${LAYERDIR}/recipes/*/*.bbappend \
            ${LAYERDIR}/recipes-*/*/*.bb \
            ${LAYERDIR}/recipes-*/*/*.bbappend"
```
